#include			<PIC16F877A.INC>
__config			H'3F31'

BANT		EQU		0X0021
YEDEK_W		EQU		0X0022
YEDEK_STAT	EQU		0X0023
YEDEK_PCL	EQU		0X0024
TMR0_SAYAC	EQU		0X0025
D1			EQU		0X0026
D2			EQU		0X0027
D3			EQU		0X0028
U_DURUM		EQU		0X0029


ORG				0X0000
GOTO			AYAR

ORG				0X0004
GOTO			KESME

ORG				0X0009
GOTO			MAIN

KESME
	BCF			INTCON,7		;HER ÝHTÝMALE KARÞIN GELECEK KESMELERÝ KAPAT
	MOVWF		YEDEK_W			;W'YÝ YEDEKLE
	MOVF		STATUS,W		;STATUSU W'YE AL
	MOVWF		YEDEK_STAT		;STATUSU YEDEKLE
	MOVF		PCLATH,W		;PCLATH W'YE AL
	MOVWF		YEDEK_PCL		;PCLATHI YEDEKLE
	BTFSS		PORTB,0			;EÐER HARÝCÝ KESME GELDÝYSE KONTROLÜ
	INCF		TMR0_SAYAC		;TMR0 1S OLANA KADAR SAYMAYA DEVAM
	BTFSC		PORTB,0
	CALL		RB0_INT
	NOP
	BTFSC		TMR0_SAYAC,4	;1 Ms ÝÇÝN GEREKLÝ BÝTÝ KONTROL ET 16 OLUNCA
	CALL		TEST
	NOP
	MOVF		YEDEK_STAT,W	;YEDEKLENMÝÞ STATUS U W YE YÜKLE
	MOVWF		STATUS			;STATUS U GERÝ YERÝNE KOY
	MOVF		YEDEK_PCL,W		;YEDEK	PCLATH I GETÝR W YE YÜKLE
	MOVWF		PCLATH			;PCL I YERÝNE KOY
	SWAPF		YEDEK_W,F		;STATUSUN ÝÇERÝÐÝNÝ BOZMADAN YEDEK W YÝ SWAPLA
	SWAPF		YEDEK_W,W		;STATUSUN ÝÇERÝÐÝNÝ BOZMADAN TEKRAR SWAPLAYIP YERÝNE KOY
	BCF			INTCON,TMR0IF	;TMR0 BAYRAÐINI ÝNDÝR
	BCF			INTCON,INTF		;RB0/INT BAYRAÐINI ÝNDÝR
	BSF			INTCON,GIE		;BÜTÜN KESMELERÝ AKTÝF ET
RETFIE							;KESMEDEN ÇIK

RB0_INT
	BCF			PORTB,4
	BSF			PORTB,5
	BSF			PORTB,6
	BSF			PORTB,7
	BTFSC		PORTB,0
	GOTO		$-1
	BSF			PORTB,4
	BCF			PORTB,5
	NOP
RETURN
	
TEST
	CLRF		TMR0_SAYAC
	BTFSS		PORTD,0			;ÜRÜNÜN GELÝP GELMEDÝÐÝ KONTROLÜ
	CALL		U_GECIKTI		;GECÝKTÝYSE
	BTFSC		PORTD,0
	CALL		U_GECIKMEDI		;GECÝKMEDÝYSE
RETURN

U_GECIKTI
	
	BSF			U_DURUM,0
	BCF			PORTB,6			;6.PÝN LEDÝ SÖNDÜR(YEÞÝL)
	BSF			PORTB,7			;7.PÝN LEDÝ YAK(KIRMIZI)
RETURN

U_GECIKMEDI
	BCF			U_DURUM,0
	BSF			PORTB,6			;6.PÝN LEDÝ SÖNDÜR(YEÞÝL)
	BCF			PORTB,7			;7.PÝN LEDÝ YAK(KIRMIZI)
	CALL		DELAY			;LED YAKMAK ÝÇÝN GEREKLÝ 0.5S GECÝKME
	BCF			PORTB,6			;6.PÝN LEDÝ YAK(YEÞÝL)
	BSF			PORTB,7			;7.PÝN LEDÝ SÖNDÜR(KIRMIZI)
RETURN

AYAR
	CLRF		PORTB
	CLRF		YEDEK_W
	CLRF		YEDEK_STAT
	CLRF		YEDEK_PCL
	CLRF		TMR0_SAYAC
	CLRF		U_DURUM
	BSF			STATUS,RP0		;BANK1'E GEÇ
	MOVLW		0X01			;W'YE PORTB NÝN PÝNLERÝNÝ AYARLAYACAK DEÐERLERÝ ATA
	MOVWF		TRISB			;PORTB NÝN 0.PÝNÝNÝ GÝRÝÞ DÝÐERLERÝNÝ ÇIKIÞ YAP
	MOVLW		0X01			;W'YE PORTD NÝN PÝNLERÝNÝ AYARLAYACAK DEÐERLERÝ ATA
	MOVWF		TRISD			;PORTD NÝN SADECE 0.PÝNLERÝNÝ GÝRÝÞ YAP
	MOVLW		B'10000111'		;BUTTON PULL-UP BAÐLIYSA 7.BÝT 1 PULL-DOWN ÝSE 0---SON 3 BÝT TMR0 ÝÇÝN GEREKLÝ VERÝLER
	MOVWF		OPTION_REG		;KESME(HEM TIMER0 HEM DE RB0) ÝÇÝN GEREKLÝ DEÐERLER OPTION_REG KAYDEDÝCÝSÝNE ATA
	MOVLW		B'00110000'
	MOVWF		INTCON			;TMR0 VE RB0/INT KESMELERÝ AKTÝF
	BCF			STATUS,RP0			;BANK0'A GEÇ
	BSF			PORTB,4
	BCF			PORTB,5
	BCF			PORTB,6
	BSF			PORTB,7
	GOTO		MAIN

MAIN
	BSF			INTCON,7		;BÜTÜN KESMELERE ÝZÝN VER
	MOVLW		D'60'
	MOVWF		TMR0
	DONGU
		BSF			PORTD,4
		BCF			PORTD,5
	GOTO		DONGU

RETURN

DELAY			;0.5s ÝÇÝN GEREKLÝ GECÝKME
	MOVLW		0X54
	MOVWF		D1
	DELAY2
		MOVLW		0X8A
		MOVWF		D2
		DELAY3
			MOVLW		0X03
			MOVWF		D3
			DELAY4
				DECFSZ		D3
				GOTO		DELAY4
				DECFSZ		D2
				GOTO		DELAY3
				DECFSZ		D1
				GOTO		DELAY2
	RETURN

END